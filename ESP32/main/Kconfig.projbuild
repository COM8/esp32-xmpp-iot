## ESP32/main/Kconfig.projbuild
```kconfig
menu "Example Configuration"

config BLINK_GPIO_RED
    int "Blink red GPIO number"
	range 0 34
	default 14
	help
		GPIO number (IOxx) to blink on and off.

		Some GPIOs are used for other purposes (flash connections, etc.) and cannot be used to blink.

		GPIOs 35-39 are input-only so cannot be used as outputs.

config BLINK_GPIO_BLUE
    int "Blink blue GPIO number"
	range 0 34
	default 12
	help
		GPIO number (IOxx) to blink on and off.

		Some GPIOs are used for other purposes (flash connections, etc.) and cannot be used to blink.

		GPIOs 35-39 are input-only so cannot be used as outputs.

config BLINK_GPIO_GREEN
    int "Blink green GPIO number"
	range 0 34
	default 27
	help
		GPIO number (IOxx) to blink on and off.

		Some GPIOs are used for other purposes (flash connections, etc.) and cannot be used to blink.

		GPIOs 35-39 are input-only so cannot be used as outputs.

endmenu
```
